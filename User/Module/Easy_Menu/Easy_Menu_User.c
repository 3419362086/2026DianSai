#include "Easy_Menu_User.h"

/* Easy Menu User Configuration File */
/* This file is auto-generated by Easy Menu Builder */
/* Configuration: Easy_Menu_Config */

/* USER CODE PUBLIC BEGIN */
#include "MyDefine.h"
/* USER CODE PUBLIC END */

/* ================================================================= 占位变量 ================================================================= */
struct {
    unsigned char led1;
    unsigned char led2;
    unsigned char led3;
    unsigned char led4;
    float roll;
    float pitch;
    float yaw;
    signed int left_pwm;
    signed int right_pwm;
    float left_rpm;
    float right_rpm;
    signed int left_target;
    float left_kp;
    float left_ki;
    float left_kd;
    signed int right_target;
    float right_kp;
    float right_ki;
    float right_kd;
    signed int left_step_speed;
    signed int right_step_speed;
    float temp;
    float rh;
    unsigned char reset_count;
} Easy_Menu_Ui_Data = {
    .led1 = 0,
    .led2 = 0,
    .led3 = 0,
    .led4 = 0,
    .roll = 0.0f,
    .pitch = 0.0f,
    .yaw = 0.0f,
    .left_pwm = 0,
    .right_pwm = 0,
    .left_rpm = 0.0f,
    .right_rpm = 0.0f,
    .left_target = 100,
    .left_kp = 0.0f,
    .left_ki = 0.0f,
    .left_kd = 0.0f,
    .right_target = 100,
    .right_kp = 0.0f,
    .right_ki = 0.0f,
    .right_kd = 0.0f,
    .left_step_speed = 0,
    .right_step_speed = 0,
    .temp = 0.0f,
    .rh = 0.0f,
    .reset_count = 0,
};
/* ============================================================== 页面、条目定义 ============================================================== */    
Show_Page start_page;
Ordinary_Page main_page;
    Goto_Item main_page_1_item;
    Goto_Item main_page_2_item;
    Goto_Item main_page_3_item;
    Goto_Item main_page_4_item;
    Goto_Item main_page_5_item;
    Goto_Item main_page_6_item;
    Goto_Item main_page_7_item;
    Goto_Item main_page_8_item;
    Goto_Item main_page_9_item;
    Goto_Item main_page_10_item;
    Goto_Item main_page_11_item;
    Show_Page rtc_page;
    Ordinary_Page led_page;
        Switch_Item led_page_1_item;
        Switch_Item led_page_2_item;
        Switch_Item led_page_3_item;
        Switch_Item led_page_4_item;
    Show_Page show_page_1;
    Ordinary_Page gyroscope_page;
        Show_Item gyroscope_page_1_item;
        Show_Item gyroscope_page_2_item;
        Show_Item gyroscope_page_3_item;
    Ordinary_Page Motor_Page;
        Goto_Item Motor_Page_1_item;
        Goto_Item Motor_Page_2_item;
        Ordinary_Page ordinary_page_2;
            Data_Item ordinary_page_2_1_item;
            Text_Item ordinary_page_2_2_item;
        Ordinary_Page ordinary_page_3;
            Data_Item ordinary_page_3_1_item;
            Text_Item ordinary_page_3_2_item;
    Ordinary_Page Encoder_Page;
        Show_Item Encoder_Page_1_item;
        Show_Item Encoder_Page_2_item;
    Ordinary_Page ordinary_page_4;
        Goto_Item ordinary_page_4_1_item;
        Goto_Item ordinary_page_4_2_item;
        Enum_Item ordinary_page_4_3_item;
        Ordinary_Page ordinary_page_5;
            Data_Item ordinary_page_5_1_item;
            Data_Item ordinary_page_5_2_item;
            Data_Item ordinary_page_5_3_item;
            Data_Item ordinary_page_5_4_item;
        Ordinary_Page ordinary_page_6;
            Data_Item ordinary_page_6_1_item;
            Data_Item ordinary_page_6_2_item;
            Data_Item ordinary_page_6_3_item;
            Data_Item ordinary_page_6_4_item;
    Ordinary_Page ordinary_page_7;
        Data_Item ordinary_page_7_1_item;
        Data_Item ordinary_page_7_2_item;
        Text_Item ordinary_page_7_3_item;
    Ordinary_Page ordinary_page_8;
        Show_Item ordinary_page_8_1_item;
        Show_Item ordinary_page_8_2_item;
    Ordinary_Page ordinary_page_9;
        Show_Item ordinary_page_9_1_item;
        Text_Item ordinary_page_9_2_item;
    Ordinary_Page ordinary_page_10;
        Text_Item ordinary_page_10_1_item;
        Text_Item ordinary_page_10_2_item;
        Text_Item ordinary_page_10_3_item;
        Text_Item ordinary_page_10_4_item;
        Text_Item ordinary_page_10_5_item;
        Text_Item ordinary_page_10_6_item;
        Text_Item ordinary_page_10_7_item;
        Text_Item ordinary_page_10_8_item;
        Goto_Item ordinary_page_10_9_item;
        Goto_Item ordinary_page_10_10_item;
        Show_Page github_page_1;
        Show_Page bilibili_page_2;
/* ================================================================= 枚举列表 ================================================================= */
char *ordinary_page_4_3_item_enum_str[2] = {
    "暂停",
    "启动"
};

/* ============================================================== 回调函数（条目） ============================================================ */
void Led_Page_1_Item_Callback(unsigned char data)
{
    /* USER CODE BEGIN */
    led_buf[0] = data;
    /* USER CODE END */
}

void Led_Page_2_Item_Callback(unsigned char data)
{
    /* USER CODE BEGIN */
    led_buf[1] = data;
    /* USER CODE END */
}

void Led_Page_3_Item_Callback(unsigned char data)
{
    /* USER CODE BEGIN */
    led_buf[2] = data;
    /* USER CODE END */
}

void Led_Page_4_Item_Callback(unsigned char data)
{
    /* USER CODE BEGIN */
    led_buf[3] = data;
    /* USER CODE END */
}

void Gyroscope_Page_1_Item_Callback(void)
{
    /* USER CODE BEGIN */
    #if BNO08x_ON == 0
        Easy_Menu_Ui_Data.roll = icm20608.Roll;
    #else
        Easy_Menu_Ui_Data.roll = bno08x.Roll;
    #endif
    /* USER CODE END */
}

void Gyroscope_Page_2_Item_Callback(void)
{
    /* USER CODE BEGIN */
    #if BNO08x_ON == 0
        Easy_Menu_Ui_Data.pitch = icm20608.Pitch;
    #else
        Easy_Menu_Ui_Data.pitch = bno08x.Pitch;
    #endif
    /* USER CODE END */
}

void Gyroscope_Page_3_Item_Callback(void)
{
    /* USER CODE BEGIN */
    #if BNO08x_ON == 0
        Easy_Menu_Ui_Data.yaw = icm20608.Yaw;
    #else
        Easy_Menu_Ui_Data.yaw = bno08x.Yaw;
    #endif
    /* USER CODE END */
}

void Ordinary_Page_2_1_Item_Callback(void *data) // *((signed int*)data)
{
    /* USER CODE BEGIN */
    Motor_Set_Speed(&left_motor, *((signed int*)data));
    /* USER CODE END */
}

void Ordinary_Page_2_2_Item_Callback(char *str)
{
    /* USER CODE BEGIN */
    Easy_Menu_Ui_Data.left_pwm = 0;
    Motor_Stop(&left_motor);
    Easy_Menu_Display_Refresh();
    /* USER CODE END */
}

void Ordinary_Page_3_1_Item_Callback(void *data) // *((signed int*)data)
{
    /* USER CODE BEGIN */
    Motor_Set_Speed(&right_motor, *((signed int*)data));
    /* USER CODE END */
}

void Ordinary_Page_3_2_Item_Callback(char *str)
{
    /* USER CODE BEGIN */
    Easy_Menu_Ui_Data.right_pwm = 0;
    Motor_Stop(&right_motor);
    Easy_Menu_Display_Refresh();
    /* USER CODE END */
}

void Encoder_Page_1_Item_Callback(void)
{
    /* USER CODE BEGIN */
    Easy_Menu_Ui_Data.left_rpm = left_encoder.rpm;
    /* USER CODE END */
}

void Encoder_Page_2_Item_Callback(void)
{
    /* USER CODE BEGIN */
    Easy_Menu_Ui_Data.right_rpm = right_encoder.rpm;
    /* USER CODE END */
}

void Ordinary_Page_4_3_Item_Callback(char *str)
{
    /* USER CODE BEGIN */

    /* USER CODE END */
}

void Ordinary_Page_5_1_Item_Callback(void *data) // *((signed int*)data)
{
    /* USER CODE BEGIN */
    basic_speed = *((signed int*)data);
    pid_set_target(&pid_speed_left, basic_speed);
    /* USER CODE END */
}

void Ordinary_Page_5_2_Item_Callback(void *data) // *((float*)data)
{
    /* USER CODE BEGIN */
    if(Easy_Menu_Ui_Data.left_kp == 0)
        Easy_Menu_Ui_Data.left_kp = pid_speed_left.kp;
    else
        pid_speed_left.kp = *((float*)data);
    /* USER CODE END */
}

void Ordinary_Page_5_3_Item_Callback(void *data) // *((float*)data)
{
    /* USER CODE BEGIN */
    if(Easy_Menu_Ui_Data.left_ki == 0)
        Easy_Menu_Ui_Data.left_ki = pid_speed_left.ki;
    else
        pid_speed_left.ki = *((float*)data);
    /* USER CODE END */
}

void Ordinary_Page_5_4_Item_Callback(void *data) // *((float*)data)
{
    /* USER CODE BEGIN */
    if(Easy_Menu_Ui_Data.left_kd == 0)
        Easy_Menu_Ui_Data.left_kd = pid_speed_left.kd;
    else
        pid_speed_left.kd = *((float*)data);
    /* USER CODE END */
}

void Ordinary_Page_6_1_Item_Callback(void *data) // *((signed int*)data)
{
    /* USER CODE BEGIN */
    basic_speed = *((signed int*)data);
    pid_set_target(&pid_speed_right, basic_speed);
    /* USER CODE END */
}

void Ordinary_Page_6_2_Item_Callback(void *data) // *((float*)data)
{
    /* USER CODE BEGIN */
    if(Easy_Menu_Ui_Data.right_kp == 0)
        Easy_Menu_Ui_Data.right_kp = pid_speed_right.kp;
    else
        pid_speed_right.kp = *((float*)data);
    /* USER CODE END */
}

void Ordinary_Page_6_3_Item_Callback(void *data) // *((float*)data)
{
    /* USER CODE BEGIN */
    if(Easy_Menu_Ui_Data.right_ki == 0)
        Easy_Menu_Ui_Data.right_ki = pid_speed_right.ki;
    else
        pid_speed_right.ki = *((float*)data);
    /* USER CODE END */
}

void Ordinary_Page_6_4_Item_Callback(void *data) // *((float*)data)
{
    /* USER CODE BEGIN */
    if(Easy_Menu_Ui_Data.right_kd == 0)
        Easy_Menu_Ui_Data.right_kd = pid_speed_right.kd;
    else
        pid_speed_right.kd = *((float*)data);
    /* USER CODE END */
}

void Ordinary_Page_7_1_Item_Callback(void *data) // *((signed int*)data)
{
    /* USER CODE BEGIN */
    Motor_Vel_Synchronous_Control(Get_X_Step_Motor_Speed(), *((signed int*)data));
    /* USER CODE END */
}

void Ordinary_Page_7_2_Item_Callback(void *data) // *((signed int*)data)
{
    /* USER CODE BEGIN */
    Motor_Vel_Synchronous_Control(*((signed int*)data), Get_Y_Step_Motor_Speed());
    /* USER CODE END */
}

void Ordinary_Page_7_3_Item_Callback(char *str)
{
    /* USER CODE BEGIN */
    Easy_Menu_Ui_Data.left_step_speed = 0;
    Easy_Menu_Ui_Data.right_step_speed = 0;
    Motor_Vel_Synchronous_Control(0, 0);
    Easy_Menu_Display_Refresh();
    /* USER CODE END */
}

void Ordinary_Page_8_1_Item_Callback(void)
{
    /* USER CODE BEGIN */
    Easy_Menu_Ui_Data.temp = Humiture.Temp;
    /* USER CODE END */
}

void Ordinary_Page_8_2_Item_Callback(void)
{
    /* USER CODE BEGIN */
    Easy_Menu_Ui_Data.rh = Humiture.RH;
    /* USER CODE END */
}

void Ordinary_Page_9_1_Item_Callback(void)
{
    /* USER CODE BEGIN */
    Easy_Menu_Ui_Data.reset_count = start_count;
    /* USER CODE END */
}

void Ordinary_Page_9_2_Item_Callback(char *str)
{
    /* USER CODE BEGIN */
    Easy_Menu_Ui_Data.reset_count = start_count = 0;
    
    spi_flash_sector_erase(0x1000);
    spi_flash_buffer_write(&start_count, 0x1000, 1);
    /* USER CODE END */
}

/* ============================================================== 回调函数（页面） ============================================================ */
/* Private variables ---------------------------------------------------------*/
/* USER CODE VALUE BEGIN */
unsigned char bmp_index = 0;
/* USER CODE VALUE END */
/* Private function ----------------------------------------------------------*/
void Start_Page_Enter_Callback(void)
{
    /* USER CODE BEGIN */

    /* USER CODE END */
}

void Start_Page_Period_Callback(void* temp, Easy_Menu_Input_TYPE user_input)
{
    /* USER CODE BEGIN */
    
    if(bmp_index < 88) 
    {
        OLED_Show_Pic(bmp_pic[bmp_index], 1);
        bmp_index++;
    }
    else if(bmp_index < 90)
    {
        OLED_Clear();
        
        OLED_ShowHzbig(0, 0, 0);
        OLED_ShowHzbig(32, 0, 1);
        
        OLED_ShowHanzi(64, 0, 0);
        OLED_ShowHanzi(80, 0, 1);
        
        OLED_ShowHanzi(80, 2, 2);
        OLED_ShowHanzi(96, 2, 3);
        OLED_ShowHanzi(112, 2, 4);
        
        bmp_index++;
    }
    
    if(user_input != EASY_MENU_NONE)
    {
        Safe_Abort_OLED_DMA();
        Easy_Menu_Goto_Page(PAGE(main_page));
    }
    /* USER CODE END */
}

void Start_Page_Exit_Callback(void)
{
    /* USER CODE BEGIN */
    OLED_Clear();
    /* USER CODE END */
}

void Rtc_Page_Enter_Callback(void)
{
    /* USER CODE BEGIN */
    Oled_Show_Chinese_Char2(0, 0, 16, (unsigned char*)"日", 0);
    Oled_Show_Chinese_Char2(16, 0, 16, (unsigned char*)"期", 0);
    OLED_ShowChar2(32, 0, ':', 16, 0);
    
    Oled_Show_Chinese_Char2(0, 2, 16, (unsigned char*)"时", 0);
    Oled_Show_Chinese_Char2(16, 2, 16, (unsigned char*)"间", 0);
    OLED_ShowChar2(32, 2, ':', 16, 0);
    /* USER CODE END */
}

void Rtc_Page_Period_Callback(void* temp, Easy_Menu_Input_TYPE user_input)
{
    /* USER CODE BEGIN */
    Oled_Printf(40, 0, 8, "20%02d-%02d-%02d ", RTC_Day.Year, RTC_Day.Month, RTC_Day.Date);
    Oled_Printf(40, 2, 8, "%02d:%02d:%02d ", RTC_Time.Hours, RTC_Time.Minutes, RTC_Time.Seconds);
    /* USER CODE END */
}

void Rtc_Page_Exit_Callback(void)
{
    /* USER CODE BEGIN */
    OLED_Clear();
    /* USER CODE END */
}

void Show_Page_1_Period_Callback(void* temp, Easy_Menu_Input_TYPE user_input)
{
    /* USER CODE BEGIN */

    Oled_Printf(0, 1, 16, "%d-%d-%d-%d-%d-%d-%d-%d",(gray_digtal>>0)&0x01,(gray_digtal>>1)&0x01,(gray_digtal>>2)&0x01,(gray_digtal>>3)&0x01,
                                                    (gray_digtal>>4)&0x01,(gray_digtal>>5)&0x01,(gray_digtal>>6)&0x01,(gray_digtal>>7)&0x01);

    /* USER CODE END */
}

void Github_Page_1_Enter_Callback(void)
{
    /* USER CODE BEGIN */
    Oled_Printf(0, 0, 8, "MistyRainDreamX");
    Oled_Printf(0, 1, 8, "https://");
    Oled_Printf(0, 2, 8, "  github.com/");
    Oled_Printf(0, 3, 8, "    2549850807");
    /* USER CODE END */
}

void Bilibili_Page_2_Enter_Callback(void)
{
    /* USER CODE BEGIN */
    Oled_Printf(0, 0, 16, "Yt");
    Oled_Show_Chinese_Char2(16, 0, 16, (unsigned char*)"禾", 0);
    Oled_Show_Chinese_Char2(32, 0, 16, (unsigned char*)"斗", 0);
    Oled_Printf(48, 0, 16, "rY");
    Oled_Printf(64, 1, 8, "https://");
    Oled_Printf(0, 2, 8, "space.bilibili");
    Oled_Printf(0, 3, 8, "     .com/301910935");
    /* USER CODE END */
}

/* =========================================================== 设置列表（普通页面） =========================================================== */
Item *main_page_items[11] = {
    ITEM(main_page_1_item),
    ITEM(main_page_2_item),
    ITEM(main_page_3_item),
    ITEM(main_page_4_item),
    ITEM(main_page_5_item),
    ITEM(main_page_6_item),
    ITEM(main_page_7_item),
    ITEM(main_page_8_item),
    ITEM(main_page_9_item),
    ITEM(main_page_10_item),
    ITEM(main_page_11_item)
};

Item *led_page_items[4] = {
    ITEM(led_page_1_item),
    ITEM(led_page_2_item),
    ITEM(led_page_3_item),
    ITEM(led_page_4_item)
};

Item *gyroscope_page_items[3] = {
    ITEM(gyroscope_page_1_item),
    ITEM(gyroscope_page_2_item),
    ITEM(gyroscope_page_3_item)
};

Item *Motor_Page_items[2] = {
    ITEM(Motor_Page_1_item),
    ITEM(Motor_Page_2_item)
};

Item *ordinary_page_2_items[2] = {
    ITEM(ordinary_page_2_1_item),
    ITEM(ordinary_page_2_2_item)
};

Item *ordinary_page_3_items[2] = {
    ITEM(ordinary_page_3_1_item),
    ITEM(ordinary_page_3_2_item)
};

Item *Encoder_Page_items[2] = {
    ITEM(Encoder_Page_1_item),
    ITEM(Encoder_Page_2_item)
};

Item *ordinary_page_4_items[3] = {
    ITEM(ordinary_page_4_1_item),
    ITEM(ordinary_page_4_2_item),
    ITEM(ordinary_page_4_3_item)
};

Item *ordinary_page_5_items[4] = {
    ITEM(ordinary_page_5_1_item),
    ITEM(ordinary_page_5_2_item),
    ITEM(ordinary_page_5_3_item),
    ITEM(ordinary_page_5_4_item)
};

Item *ordinary_page_6_items[4] = {
    ITEM(ordinary_page_6_1_item),
    ITEM(ordinary_page_6_2_item),
    ITEM(ordinary_page_6_3_item),
    ITEM(ordinary_page_6_4_item)
};

Item *ordinary_page_7_items[3] = {
    ITEM(ordinary_page_7_1_item),
    ITEM(ordinary_page_7_2_item),
    ITEM(ordinary_page_7_3_item)
};

Item *ordinary_page_8_items[2] = {
    ITEM(ordinary_page_8_1_item),
    ITEM(ordinary_page_8_2_item)
};

Item *ordinary_page_9_items[2] = {
    ITEM(ordinary_page_9_1_item),
    ITEM(ordinary_page_9_2_item)
};

Item *ordinary_page_10_items[10] = {
    ITEM(ordinary_page_10_1_item),
    ITEM(ordinary_page_10_2_item),
    ITEM(ordinary_page_10_3_item),
    ITEM(ordinary_page_10_4_item),
    ITEM(ordinary_page_10_5_item),
    ITEM(ordinary_page_10_6_item),
    ITEM(ordinary_page_10_7_item),
    ITEM(ordinary_page_10_8_item),
    ITEM(ordinary_page_10_9_item),
    ITEM(ordinary_page_10_10_item)
};

/* ================================================================ 系统初始化 ================================================================ */
void Easy_Menu_Ui_Init(void)
{
    Show_Page_Init(NULL, PAGE(start_page), "Start page", 16, Start_Page_Enter_Callback, Start_Page_Period_Callback, Start_Page_Exit_Callback);
    Ordinary_Page_Init(NULL, PAGE(main_page), "Main", main_page_items, 11);
        Goto_Item_Init(PAGE(main_page), ITEM(main_page_1_item), "RTC 时钟", PAGE(rtc_page));
        Goto_Item_Init(PAGE(main_page), ITEM(main_page_2_item), "LED 控制", PAGE(led_page));
        Goto_Item_Init(PAGE(main_page), ITEM(main_page_3_item), "灰度传感器", PAGE(show_page_1));
        Goto_Item_Init(PAGE(main_page), ITEM(main_page_4_item), "陀螺仪", PAGE(gyroscope_page));
        Goto_Item_Init(PAGE(main_page), ITEM(main_page_5_item), "直流电机", PAGE(Motor_Page));
        Goto_Item_Init(PAGE(main_page), ITEM(main_page_6_item), "编码器", PAGE(Encoder_Page));
        Goto_Item_Init(PAGE(main_page), ITEM(main_page_7_item), "PID 控制", PAGE(ordinary_page_4));
        Goto_Item_Init(PAGE(main_page), ITEM(main_page_8_item), "步进电机", PAGE(ordinary_page_7));
        Goto_Item_Init(PAGE(main_page), ITEM(main_page_9_item), "温湿度传感器", PAGE(ordinary_page_8));
        Goto_Item_Init(PAGE(main_page), ITEM(main_page_10_item), "Flash", PAGE(ordinary_page_9));
        Goto_Item_Init(PAGE(main_page), ITEM(main_page_11_item), "关于", PAGE(ordinary_page_10));
    Show_Page_Init(PAGE(main_page), PAGE(rtc_page), "RTC 时钟", 100, Rtc_Page_Enter_Callback, Rtc_Page_Period_Callback, Rtc_Page_Exit_Callback);
    Ordinary_Page_Init(PAGE(main_page), PAGE(led_page), "LED 控制", led_page_items, 4);
        Switch_Item_Init(PAGE(led_page), ITEM(led_page_1_item), "LED1", &Easy_Menu_Ui_Data.led1, Led_Page_1_Item_Callback);
        Switch_Item_Init(PAGE(led_page), ITEM(led_page_2_item), "LED2", &Easy_Menu_Ui_Data.led2, Led_Page_2_Item_Callback);
        Switch_Item_Init(PAGE(led_page), ITEM(led_page_3_item), "LED3", &Easy_Menu_Ui_Data.led3, Led_Page_3_Item_Callback);
        Switch_Item_Init(PAGE(led_page), ITEM(led_page_4_item), "LED4", &Easy_Menu_Ui_Data.led4, Led_Page_4_Item_Callback);
    Show_Page_Init(PAGE(main_page), PAGE(show_page_1), "灰度传感器", 10, NULL, Show_Page_1_Period_Callback, NULL);
    Ordinary_Page_Init(PAGE(main_page), PAGE(gyroscope_page), "陀螺仪", gyroscope_page_items, 3);
        Show_Item_Init(PAGE(gyroscope_page), ITEM(gyroscope_page_1_item), "Roll", FLOAT, &Easy_Menu_Ui_Data.roll, 5, Gyroscope_Page_1_Item_Callback);
        Show_Item_Init(PAGE(gyroscope_page), ITEM(gyroscope_page_2_item), "Pitch", FLOAT, &Easy_Menu_Ui_Data.pitch, 5, Gyroscope_Page_2_Item_Callback);
        Show_Item_Init(PAGE(gyroscope_page), ITEM(gyroscope_page_3_item), "Yaw", FLOAT, &Easy_Menu_Ui_Data.yaw, 5, Gyroscope_Page_3_Item_Callback);
    Ordinary_Page_Init(PAGE(main_page), PAGE(Motor_Page), "直流电机", Motor_Page_items, 2);
        Goto_Item_Init(PAGE(Motor_Page), ITEM(Motor_Page_1_item), "左电机", PAGE(ordinary_page_2));
        Goto_Item_Init(PAGE(Motor_Page), ITEM(Motor_Page_2_item), "右电机", PAGE(ordinary_page_3));
    Ordinary_Page_Init(PAGE(Motor_Page), PAGE(ordinary_page_2), "左电机", ordinary_page_2_items, 2);
        Data_Item_Init(PAGE(ordinary_page_2), ITEM(ordinary_page_2_1_item), "PWM", SIGNED_INT, &Easy_Menu_Ui_Data.left_pwm, SIGNED_INT_VAL(100), 1, SIGNED_INT_VAL(-1000), 1, SIGNED_INT_VAL(1000), 1, Ordinary_Page_2_1_Item_Callback);
        Text_Item_Init(PAGE(ordinary_page_2), ITEM(ordinary_page_2_2_item), "重置", Ordinary_Page_2_2_Item_Callback);
    Ordinary_Page_Init(PAGE(Motor_Page), PAGE(ordinary_page_3), "右电机", ordinary_page_3_items, 2);
        Data_Item_Init(PAGE(ordinary_page_3), ITEM(ordinary_page_3_1_item), "PWM", SIGNED_INT, &Easy_Menu_Ui_Data.right_pwm, SIGNED_INT_VAL(100), 1, SIGNED_INT_VAL(-1000), 1, SIGNED_INT_VAL(1000), 1, Ordinary_Page_3_1_Item_Callback);
        Text_Item_Init(PAGE(ordinary_page_3), ITEM(ordinary_page_3_2_item), "重置", Ordinary_Page_3_2_Item_Callback);
    Ordinary_Page_Init(PAGE(main_page), PAGE(Encoder_Page), "编码器", Encoder_Page_items, 2);
        Show_Item_Init(PAGE(Encoder_Page), ITEM(Encoder_Page_1_item), "左 RPM", FLOAT, &Easy_Menu_Ui_Data.left_rpm, 10, Encoder_Page_1_Item_Callback);
        Show_Item_Init(PAGE(Encoder_Page), ITEM(Encoder_Page_2_item), "右 RPM", FLOAT, &Easy_Menu_Ui_Data.right_rpm, 10, Encoder_Page_2_Item_Callback);
    Ordinary_Page_Init(PAGE(main_page), PAGE(ordinary_page_4), "PID 控制", ordinary_page_4_items, 3);
        Goto_Item_Init(PAGE(ordinary_page_4), ITEM(ordinary_page_4_1_item), "左轮速度环", PAGE(ordinary_page_5));
        Goto_Item_Init(PAGE(ordinary_page_4), ITEM(ordinary_page_4_2_item), "右轮速度环", PAGE(ordinary_page_6));
        Enum_Item_Init(PAGE(ordinary_page_4), ITEM(ordinary_page_4_3_item), "状态", ordinary_page_4_3_item_enum_str, 2, Ordinary_Page_4_3_Item_Callback);
    Ordinary_Page_Init(PAGE(ordinary_page_4), PAGE(ordinary_page_5), "左轮速度环", ordinary_page_5_items, 4);
        Data_Item_Init(PAGE(ordinary_page_5), ITEM(ordinary_page_5_1_item), "目标值", SIGNED_INT, &Easy_Menu_Ui_Data.left_target, SIGNED_INT_VAL(50), 1, SIGNED_INT_VAL(0), 0, SIGNED_INT_VAL(0), 0, Ordinary_Page_5_1_Item_Callback);
        Data_Item_Init(PAGE(ordinary_page_5), ITEM(ordinary_page_5_2_item), "Kp", FLOAT, &Easy_Menu_Ui_Data.left_kp, FLOAT_VAL(0.1), 1, FLOAT_VAL(0), 0, FLOAT_VAL(0), 0, Ordinary_Page_5_2_Item_Callback);
        Data_Item_Init(PAGE(ordinary_page_5), ITEM(ordinary_page_5_3_item), "Ki", FLOAT, &Easy_Menu_Ui_Data.left_ki, FLOAT_VAL(0.1), 1, FLOAT_VAL(0), 0, FLOAT_VAL(0), 0, Ordinary_Page_5_3_Item_Callback);
        Data_Item_Init(PAGE(ordinary_page_5), ITEM(ordinary_page_5_4_item), "Kd", FLOAT, &Easy_Menu_Ui_Data.left_kd, FLOAT_VAL(0.1), 1, FLOAT_VAL(0), 0, FLOAT_VAL(0), 0, Ordinary_Page_5_4_Item_Callback);
    Ordinary_Page_Init(PAGE(ordinary_page_4), PAGE(ordinary_page_6), "右轮速度环", ordinary_page_6_items, 4);
        Data_Item_Init(PAGE(ordinary_page_6), ITEM(ordinary_page_6_1_item), "目标值", SIGNED_INT, &Easy_Menu_Ui_Data.right_target, SIGNED_INT_VAL(50), 1, SIGNED_INT_VAL(0), 0, SIGNED_INT_VAL(0), 0, Ordinary_Page_6_1_Item_Callback);
        Data_Item_Init(PAGE(ordinary_page_6), ITEM(ordinary_page_6_2_item), "Kp", FLOAT, &Easy_Menu_Ui_Data.right_kp, FLOAT_VAL(0.1), 1, FLOAT_VAL(0), 0, FLOAT_VAL(0), 0, Ordinary_Page_6_2_Item_Callback);
        Data_Item_Init(PAGE(ordinary_page_6), ITEM(ordinary_page_6_3_item), "Ki", FLOAT, &Easy_Menu_Ui_Data.right_ki, FLOAT_VAL(0.1), 1, FLOAT_VAL(0), 0, FLOAT_VAL(0), 0, Ordinary_Page_6_3_Item_Callback);
        Data_Item_Init(PAGE(ordinary_page_6), ITEM(ordinary_page_6_4_item), "Kd", FLOAT, &Easy_Menu_Ui_Data.right_kd, FLOAT_VAL(0.1), 1, FLOAT_VAL(0), 0, FLOAT_VAL(0), 0, Ordinary_Page_6_4_Item_Callback);
    Ordinary_Page_Init(PAGE(main_page), PAGE(ordinary_page_7), "步进电机", ordinary_page_7_items, 3);
        Data_Item_Init(PAGE(ordinary_page_7), ITEM(ordinary_page_7_1_item), "左电机转速", SIGNED_INT, &Easy_Menu_Ui_Data.left_step_speed, SIGNED_INT_VAL(100), 1, SIGNED_INT_VAL(0), 0, SIGNED_INT_VAL(0), 0, Ordinary_Page_7_1_Item_Callback);
        Data_Item_Init(PAGE(ordinary_page_7), ITEM(ordinary_page_7_2_item), "右电机转速", SIGNED_INT, &Easy_Menu_Ui_Data.right_step_speed, SIGNED_INT_VAL(100), 1, SIGNED_INT_VAL(0), 0, SIGNED_INT_VAL(0), 0, Ordinary_Page_7_2_Item_Callback);
        Text_Item_Init(PAGE(ordinary_page_7), ITEM(ordinary_page_7_3_item), "重置", Ordinary_Page_7_3_Item_Callback);
    Ordinary_Page_Init(PAGE(main_page), PAGE(ordinary_page_8), "温湿度传感器", ordinary_page_8_items, 2);
        Show_Item_Init(PAGE(ordinary_page_8), ITEM(ordinary_page_8_1_item), "温度", FLOAT, &Easy_Menu_Ui_Data.temp, 100, Ordinary_Page_8_1_Item_Callback);
        Show_Item_Init(PAGE(ordinary_page_8), ITEM(ordinary_page_8_2_item), "湿度", FLOAT, &Easy_Menu_Ui_Data.rh, 100, Ordinary_Page_8_2_Item_Callback);
    Ordinary_Page_Init(PAGE(main_page), PAGE(ordinary_page_9), "Flash", ordinary_page_9_items, 2);
        Show_Item_Init(PAGE(ordinary_page_9), ITEM(ordinary_page_9_1_item), "重启次数", UNSIGNED_CHAR, &Easy_Menu_Ui_Data.reset_count, 10, Ordinary_Page_9_1_Item_Callback);
        Text_Item_Init(PAGE(ordinary_page_9), ITEM(ordinary_page_9_2_item), "重置", Ordinary_Page_9_2_Item_Callback);
    Ordinary_Page_Init(PAGE(main_page), PAGE(ordinary_page_10), "关于", ordinary_page_10_items, 10);
        Text_Item_Init(PAGE(ordinary_page_10), ITEM(ordinary_page_10_1_item), "米醋电控板", NULL);
        Text_Item_Init(PAGE(ordinary_page_10), ITEM(ordinary_page_10_2_item), "外设测试例程", NULL);
        Text_Item_Init(PAGE(ordinary_page_10), ITEM(ordinary_page_10_3_item), "环境:", NULL);
        Text_Item_Init(PAGE(ordinary_page_10), ITEM(ordinary_page_10_4_item), "米醋电控板 V2", NULL);
        Text_Item_Init(PAGE(ordinary_page_10), ITEM(ordinary_page_10_5_item), "作者:", NULL);
        Text_Item_Init(PAGE(ordinary_page_10), ITEM(ordinary_page_10_6_item), "烟雨梦兮", NULL);
        Text_Item_Init(PAGE(ordinary_page_10), ITEM(ordinary_page_10_7_item), "菜单框架:", NULL);
        Text_Item_Init(PAGE(ordinary_page_10), ITEM(ordinary_page_10_8_item), "Easy_Menu V3", NULL);
        Goto_Item_Init(PAGE(ordinary_page_10), ITEM(ordinary_page_10_9_item), "Github:", PAGE(github_page_1));
        Goto_Item_Init(PAGE(ordinary_page_10), ITEM(ordinary_page_10_10_item), "Bilibili:", PAGE(bilibili_page_2));
    Show_Page_Init(PAGE(ordinary_page_10), PAGE(github_page_1), "Github:", 100, Github_Page_1_Enter_Callback, NULL, NULL);
    Show_Page_Init(PAGE(ordinary_page_10), PAGE(bilibili_page_2), "Bilibili:", 100, Bilibili_Page_2_Enter_Callback, NULL, NULL);
    
    Easy_Menu_Goto_Page(PAGE(start_page));
}
